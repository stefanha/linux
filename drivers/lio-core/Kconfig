## drivers/lio-core/Kconfig
```kconfig
config LIO_TARGET
        tristate "Linux-iSCSI.org iSCSI Target Mode Stack"
        default m
        depends on TARGET_CORE
	select CONFIGFS_FS
        ---help---
        Say Y here to enable the ConfigFS enabled Linux-iSCSI.org iSCSI Target Mode Stack
```

## drivers/target/Kconfig
```kconfig
config TARGET_CORE
        tristate "Generic Target Core Mod (TCM) and ConfigFS Infrastructure"
	select CONFIGFS_FS
        default m
        ---help---
        Say Y or M here to enable the TCM Storage Engine and ConfigFS enabled control path for target_core_mod.  This includes built-in TCM RAMDISK subsystem logic for virtual LUN 0 access

config TCM_DEBUG_DEV
	tristate "TCM Debug device code"
	depends on TARGET_CORE
	default n
	---help---
	Say Y here to enable the TCM Debug device code

config TCM_IBLOCK
	tristate "TCM/IBLOCK Subsystem Plugin for Linux/BLOCK"
	depends on TARGET_CORE
	default y
	---help---
	Say Y here to enable the TCM/IBLOCK subsystem plugin for non-buffered access to Linux/Block devices using BIO

config TCM_FILEIO
	tristate "TCM/FILEIO Subsystem Plugin for Linux/VFS"
	depends on TARGET_CORE
	default y
	---help---
	Say Y here to enable the TCM/FILEIO subsystem plugin for buffered access to Linux/VFS struct file or struct block_device

config TCM_PSCSI
	tristate "TCM/pSCSI Subsystem Plugin for Linux/SCSI"
	depends on TARGET_CORE
	default y
	---help---
	Say Y here to enable the TCM/pSCSI subsystem plugin for non-buffered passthrough access to Linux/SCSI device

config TCM_STGT
	tristate "TCM/STGT Subsystem Plugin"
	depends on TARGET_CORE && EXPERIMENTAL
	select SCSI_TGT
	default n
	---help---
	Say Y here to enable the WIP TCM/STGT subsystem plugin for accessing STGT device

source "drivers/target/tcm_loop/Kconfig"
source "drivers/target/lio-target/Kconfig"
source "drivers/target/tcm_fc/Kconfig"
```

## drivers/target/iscsi/Kconfig
```kconfig
config ISCSI_TARGET
	tristate "Linux-iSCSI.org iSCSI Target Mode Stack"
	select CRYPTO
	select CRYPTO_CRC32C
	select CRYPTO_CRC32C_INTEL if X86
	help
	Say M here to enable the ConfigFS enabled Linux-iSCSI.org iSCSI
	Target Mode Stack.

if ISCSI_TARGET

config ISCSI_TARGET_DEBUG
	bool "LIO-Target iscsi_debug.h ring buffer messages"
	help
	Say Y here to enable the legacy DEBUG_ISCSI macros in iscsi_debug.h

endif
```

## drivers/target/lio-target/Kconfig
```kconfig
config LIO_TARGET
	tristate "Linux-iSCSI.org iSCSI Target Mode Stack"
	help
	Say Y here to enable the ConfigFS enabled Linux-iSCSI.org iSCSI
	Target Mode Stack.

config LIO_TARGET_DEBUG
	bool "LIO-Target iscsi_debug.h ring buffer messages"
	help
	Say Y here to enable the legacy DEBUG_ISCSI macros in iscsi_debug.h

config LIO_TARGET_DEBUG_ERL
	bool "LIO-Target ErrorRecoveryLevel debug code"
	help
	Say Y here to enable the iSCSI ErrorRecoveryLevel debugging code.
	
```

## drivers/target/tcm_fc/Kconfig
```kconfig
config TCM_FC
	tristate "TCM_FC fabric Plugin"
	depends on TARGET_CORE && LIBFC
	default n
	---help---
	Say Y here to enable the TCM FC plugin for accessing FC fabrics in TCM
```

## drivers/target/tcm_loop/Kconfig
```kconfig
config TCM_LOOP_FABRIC
	tristate "TCM Virtual SAS target and Linux/SCSI LDD fabric loopback module"
	help
	Say Y here to enable the TCM Virtual SAS target and Linux/SCSI LLD
	fabric loopback module.

config TCM_LOOP_CDB_DEBUG
	bool "TCM loopback fabric module CDB debug code"
	depends on TCM_LOOP_FABRIC
	help
	Say Y here to enable the TCM loopback fabric module CDB debug code
```

## drivers/target/tcm_qla2xxx/Kconfig
```kconfig
config TCM_QLA2XXX
	tristate "TCM_QLA2XXX fabric module for Qlogic 2xxx series target mode HBAs"
	select LIBFC
	select SCSI_LOWLEVEL
	select SCSI_QLA_FC
	default n
	---help---
	Say Y here to enable the TCM_QLA2XXX fabric module for Qlogic 2xxx series target mode HBAs 
```

## drivers/target/tcm_vhost/Kconfig
```kconfig
config TCM_VHOST
	tristate "TCM_VHOST fabric module (EXPERIMENTAL)"
	depends on TARGET_CORE && CONFIGFS_FS && EVENTFD && EXPERIMENTAL && m
	default n
	---help---
	Say Y here to enable the TCM_VHOST fabric module
```
